## conf/bblayers.conf
```bitbake
POKY_BBLAYERS_CONF_VERSION = "2"

BBPATH = "${TOPDIR}"
BSPDIR := "${@os.path.abspath(os.path.dirname(d.getVar('FILE', True)) + '/../..')}"

BBFILES ?= ""
BBLAYERS = " \
  ${BSPDIR}/sources/poky/meta \
  ${BSPDIR}/sources/poky/meta-poky \
  \
  ${BSPDIR}/sources/meta-openembedded/meta-oe \
  ${BSPDIR}/sources/meta-openembedded/meta-multimedia \
  ${BSPDIR}/sources/meta-openembedded/meta-python \
  ${BSPDIR}/sources/meta-openembedded/meta-networking \
  ${BSPDIR}/sources/meta-openembedded/meta-webserver \
  \
  ${BSPDIR}/sources/meta-freescale \
  ${BSPDIR}/sources/meta-freescale-3rdparty \
  ${BSPDIR}/sources/meta-freescale-distro \
  \
  ${BSPDIR}/sources/meta-qt5 \
  ${BSPDIR}/sources/meta-openembedded/meta-ruby \
  ${BSPDIR}/sources/meta-wbd \
"
```

## conf/local.conf
```bitbake
MACHINE ??= 'wandboard'

DISTRO ?= 'poky'
DISTRO_FEATURES_append = " \
	ssh-openssh-server \
	ext2 \
	pam \
	bluetooth \
	bluez5 \
	wifi \
	opengl \
	usbhost \
	${DISTRO_FEATURES_LIBC} \
	"
DISTRO_FEATURES_remove = "x11 wayland"

PACKAGE_CLASSES ?= "package_ipk"

USER_CLASSES ?= "buildstats image-mklibs image-prelink"

PATCHRESOLVE = "noop"

BB_DISKMON_DIRS = "\
    STOPTASKS,${TMPDIR},1G,100K \
    STOPTASKS,${DL_DIR},1G,100K \
    STOPTASKS,${SSTATE_DIR},1G,100K \
    STOPTASKS,/tmp,100M,100K \
    ABORT,${TMPDIR},100M,1K \
    ABORT,${DL_DIR},100M,1K \
    ABORT,${SSTATE_DIR},100M,1K \
    ABORT,/tmp,10M,1K"

PACKAGECONFIG_append_pn-qemu-native = " sdl"

PACKAGECONFIG_append_pn-nativesdk-qemu = " sdl"

CONF_VERSION = "1"

DL_DIR ?= "${BSPDIR}/downloads/"

ACCEPT_FSL_EULA = "1"

RM_OLD_IMAGE = "1"

IMAGE_FSTYPES = "tar.bz2 ext3 sdcard"

EXTRA_IMAGE_FEATURES ?= "debug-tweaks package-management"
IMAGE_INSTALL_append = " \
	opkg \
	opkg-utils \
	bash \
	connman \
	connman-conf \
	openssh \
	wpa-supplicant \
	vim \
	lsof \
	netcat \
	iptables \
	arptables \
	nginx \
	traceroute \
	ntp \
	ipsec-tools \
	tcpdump \
	phytool \
	macchanger \
	hostapd \
	python-smbus \
	vsftpd \
	ifupdown \
	init-ifupdown \
	linux-firmware-bcm4339 \
	firmware-imx \
	bcm4339-nvram-config \
	"
# Maybe add following line
# bcm4339-nvram-config 

PACKAGE_FEED_URIS = "http://192.168.1.157:8000"
PACKAGE_FEED_BASE_PATHS = "ipk"
PACKAGE_FEED_ARCHS = "all cortexa9hf-neon wandboard cortexa9hf-neon-mx6qdl"

# Systemd
DISTRO_FEATURES_append = " systemd"
VIRTUAL-RUNTIME_init_manager = "systemd"
DISTRO_FEATURES_BACKFILL_CONSIDERED = "sysvinit"
VIRTUAL-RUNTIME_initscripts = ""

# U-Boot variables for extlinux.conf
UBOOT_EXTLINUX_FDT = "../imx6dl-wandboard-revd1.dtb"
UBOOT_EXTLINUX_FDTDIR = "../"
UBOOT_EXTLINUX_ROOT = "root=/dev/mmcblk2p2"
```
